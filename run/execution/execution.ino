#include <EloquentTinyML.h>
// Include the neural network hex array generated by Python
#include "model_data.h" 

// ==========================================
// MACHINE LEARNING CONFIGURATION
// ==========================================
#define NUMBER_OF_INPUTS 200
#define NUMBER_OF_OUTPUTS 3
// The arena size dictates how much SRAM is allocated for the neural network operations.
// 8192 (8KB) is sufficient for a 64x32 MLP.
#define TENSOR_ARENA_SIZE 16384

// Instantiate the TinyML model wrapper
Eloquent::TinyML::TfLite<NUMBER_OF_INPUTS, NUMBER_OF_OUTPUTS, TENSOR_ARENA_SIZE> ml;

// ==========================================
// HARDWARE CONFIGURATION
// ==========================================
const int micPin = A0;
const int buttonPin = 2;
const int ledPin = 3;

// Example L293D Motor Pins
const int leftMotorForward = 5;
const int rightMotorForward = 9;

int features[NUMBER_OF_INPUTS];
// TFLite requires inputs as float arrays
float input_tensor[NUMBER_OF_INPUTS]; 

int ambientNoiseAverage = 0;
int threshold = 0;
const int thresholdMargin = 15;

void setup() {
  Serial.begin(115200);
  
  pinMode(buttonPin, INPUT_PULLUP);
  pinMode(ledPin, OUTPUT);
  pinMode(leftMotorForward, OUTPUT);
  pinMode(rightMotorForward, OUTPUT);
  
  digitalWrite(ledPin, LOW);
  
  // Initialize the Neural Network
  ml.begin(acoustic_nn_model);
  
  delay(1000);
  calibrateEnvironment();
}

void calibrateEnvironment() {
  long sumOfReadings = 0;
  for (int i = 0; i < 500; i++) {
    sumOfReadings += analogRead(micPin);
    delay(2); 
  }
  ambientNoiseAverage = sumOfReadings / 500;
  threshold = ambientNoiseAverage + thresholdMargin;
}

void loop() {
  digitalWrite(ledPin, HIGH);
  
  while (digitalRead(buttonPin) == HIGH) {
    // Wait for physical trigger
  }
  
  digitalWrite(ledPin, LOW);
  
  // 1. CAPTURE PHASE
  for (int i = 0; i < NUMBER_OF_INPUTS; i++) {
    // Center the data identically to how it was captured in the dataset
    int raw_val = analogRead(micPin) - threshold;
    features[i] = raw_val;
    
    // Neural Networks require floats.
    // Note: If you used StandardScaler in Python, you must mathematically replicate 
    // the (X - mean) / std deviation calculation here using the constants from your Python scaler.
    // For simplicity, this example passes the raw centered value.
    input_tensor[i] = (float)raw_val; 
    
    delay(5); 
  }
  
  // 2. INFERENCE PHASE
  // Output array to hold the Softmax probabilities (0.0 to 1.0)
  float probabilities[NUMBER_OF_OUTPUTS]; 
  
  // Run the forward pass
  ml.predict(input_tensor, probabilities);
  
  // Determine which class has the highest probability
  int predicted_class = ml.probaToClass(probabilities);
  
  // 3. HARDWARE EXECUTION PHASE
  Serial.print("Predicted Class: ");
  Serial.println(predicted_class);
  
  if (predicted_class == 0 && probabilities[0] > 0.70) {
    // Logic for "Front"
    digitalWrite(leftMotorForward, HIGH);
    digitalWrite(rightMotorForward, HIGH);
    delay(1000); // Drive for 1 second
    digitalWrite(leftMotorForward, LOW);
    digitalWrite(rightMotorForward, LOW);
  } 
  else if (predicted_class == 1 && probabilities[1] > 0.70) {
    // Logic for "Back"
    // Apply reverse motor logic here
  }
  
  // Cooldown debounce
  delay(500);
}